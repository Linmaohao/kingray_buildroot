## configs/rockchip_rk3308_b_recovery_defconfig
```kconfig
BR2_PACKAGE_ROCKCHIP=y
BR2_PACKAGE_RK3308=y
BR2_PACKAGE_RECOVERY=y
BR2_PACKAGE_RECOVERY_NO_UI=y
BR2_PACKAGE_RECOVERY_USE_UPDATEENGINE=y
BR2_PACKAGE_RECOVERY_RECOVERYBIN=y
```

## package/kingray/Config.in
```kconfig
config BR2_PACKAGE_KINGRAY
        bool "Kingray Platform"
	help
	  Enable Kingray Platform

if BR2_PACKAGE_KINGRAY

menu "Kingray packages"
	source "package/kingray/tee-kingray/Config.in"
	source "package/kingray/krupdate/Config.in"
endmenu

endif
```

## package/kingray/krupdate/Config.in
```kconfig
config BR2_PACKAGE_KRUPDATE
	bool "Kingray update tools"
	help
	  Kingray update tools.
```

## package/kingray/tee-kingray/Config.in
```kconfig
config BR2_PACKAGE_TEE_KINGRAY
	bool "Kingray TEE user App or linux"
	help
	  Kingray TEE user App or linux.

if BR2_PACKAGE_TEE_KINGRAY

config BR2_PACKAGE_TEE_KINGRAY_COMPILE_CMD
	string "compile command"
	default "6432"
	help
	  Kingray tee_kingray compile cammad.

config BR2_PACKAGE_TEE_KINGRAY_TEE_VERSION
	string "TEE version"
	default "v2"
	help
	  Kingray TEE version.

config BR2_PACKAGE_TEE_KINGRAY_EXTRA_TOOLCHAIN
	string "Extra toolchain if neccessary"
	default "None"
	help
	  Extra toolchain if neccessary

endif
```
